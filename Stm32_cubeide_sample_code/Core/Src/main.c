/* USER CODE BEGIN Header */
/**
 ******************************************************************************
 * @file           : main.c
 * @brief          : Main program body
 ******************************************************************************
 * @attention
 *
 * Copyright (c) 2025 STMicroelectronics.
 * All rights reserved.
 *
 * This software is licensed under terms that can be found in the LICENSE file
 * in the root directory of this software component.
 * If no LICENSE file comes with this software, it is provided AS-IS.
 *
 ******************************************************************************
 */
/* USER CODE END Header */
/* Includes ------------------------------------------------------------------*/
#include "main.h"
#include "adc.h"
#include "dma.h"
#include "i2c.h"
#include "spi.h"
#include "tim.h"
#include "usart.h"
#include "gpio.h"

/* Private includes ----------------------------------------------------------*/
/* USER CODE BEGIN Includes */

#include <stdbool.h>  //For bool
#include "yarn_states.h"
#include "Led_states.h"
#include "ir_decoder.h"
#include "ws2812.h"
#include "fonts.h"
#include "ssd1306.h"
#include "bitmap.h"
#include "manage_OLED.h"
#include <stdio.h> // For sprintf
#include <stdint.h>

/* USER CODE END Includes */

/* Private typedef -----------------------------------------------------------*/
/* USER CODE BEGIN PTD */

/* USER CODE END PTD */

/* Private define ------------------------------------------------------------*/
/* USER CODE BEGIN PD */

/* USER CODE END PD */

/* Private macro -------------------------------------------------------------*/
/* USER CODE BEGIN PM */
#define OUTPUT_Pin GPIO_PIN_7
#define OUTPUT_GPIO_Port GPIOC
//SPI--> adjusting transmitter power
#define CS_GPIO_PORT GPIOA
#define CS_PIN GPIO_PIN_15
extern SPI_HandleTypeDef hspi1; // Generated by CubeMX
/* USER CODE END PM */

/* Private variables ---------------------------------------------------------*/

/* USER CODE BEGIN PV */

volatile uint16_t adc1_data[6];
volatile uint16_t adc2_data[6];
volatile uint8_t command = 100; // Global variable
volatile uint8_t newIRDataFlag = 0;
volatile uint8_t FlagCheckState = 0;    // Flag to trigger 600 ms task
volatile uint8_t FlagLedState = 0;    // Flag to trigger 100 ms task
volatile uint8_t overFlowFlag; // this counter goes to 10 to create 1 sec from 10ms, in case we need blink in neopixels
bool IRreceive = 0;
bool IRreceivePre = 0;
bool out_command = 0;  // خروجی 24 ولت است
bool outCircuit = 0;  // once is set to 1, the sensor output is low
bool outCircuitPre = 0;
bool outHigh = 0;  // outHigh =1 means out put is high
volatile uint8_t ledColor; // 0: led off, 1: dirt1, 2:dirt2, 3:flaw, 4: torn, 5:Outcircuit
volatile uint8_t flaw_ind[12] = { 0 }; // A vector contains all channles with flaw state
volatile uint8_t dirt_ind[12] = { 0 }; // A vector contains all channles with dirt state
uint8_t cnt_flaw = 0;         // number of channels with flaw state
uint8_t cnt_dirt = 0;		  // number of channels with dirt state
bool torn_stat;
bool torn_statPre;
int int_calib = 600, calib_tim = 5000; // for 5000 sec we compute threshold every 600ms, since the decision function is 600ms
bool all_off = 1;
volatile uint8_t ind = 0;    // define index of led
volatile bool direc = 1; //0= backward, 1= forward  direction of led getting on
bool Blink = 1;
uint16_t wr_buf[WR_BUF_LEN] = { 0 };
uint8_t rgb_arr[3 * num_led] = { 0 };
bool anyUpdate;   // if any channel changes in state
uint8_t indec;
bool first_comp = 1; // if sensors are read for the first time we set the max and min to their reset values
bool flag = 1;
uint32_t counter;
uint8_t Oled_statePre, Oled_state;  // 123: dirt & flaw, 4: torn, 5: out circuit

uint8_t i_cnt_dirt;	// if the oled display is full we need to save the indices (which are not shown) in i_cnt_dirt
uint8_t i_cnt_flaw; // and i_cnt_flaw to display them in the next page after 2 sec
bool elapsed = 1;  // after counter_oled reached 20, elapsed gets 1
uint8_t blink_oled; // to change the page in oled, 0,1,2 are the first, second and third page.
uint8_t blink_oledPre = 100;
uint8_t counter_oled; // the main oled function (decide_Oled) is every 100ms. so counter_oled counts to 20 to make 2 second between two pages

//uint8_t transmitter_power = 255;
//bool rise = 1;

/* USER CODE END PV */

/* Private function prototypes -----------------------------------------------*/
void SystemClock_Config(void);
/* USER CODE BEGIN PFP */
//tasks after each adc read (50us) adjusted by tim1
//the max and min perturbation between all reads (every 50us) are computed
void HAL_ADC_ConvCpltCallback(ADC_HandleTypeDef *hadc) {
	if (first_comp == 1) {
		first_comp = 0;
		for (int i = 0; i < NUM_YARN; i++) {
			yarn[i].minim = (1 << 12) - 1;
			yarn[i].maxim = 0;
		}
	}
	if (hadc->Instance == ADC2) {
		for (int i = 0; i < NUM_YARN / 2; i++) {
			yarn[i].read_sens = adc2_data[i];
			comp_thresh_perturb(&yarn[i]);
		}
	} else if (hadc->Instance == ADC1) {
		for (int i = NUM_YARN / 2; i < NUM_YARN; i++) {
			yarn[i].read_sens = adc1_data[i - 6];
			comp_thresh_perturb(&yarn[i]);
		}
	}
}
//tim2 , neopixels 100ms,check state 600ms
void HAL_TIM_PeriodElapsedCallback(TIM_HandleTypeDef *htim) {

	if (htim->Instance == TIM2) {
		FlagLedState = 1;
		counter++;
		if (counter > 5) {  // counts to create 600ms
			counter = 0;
			FlagCheckState = 1;
		}
	}

}

//manage leds (100ms)
void manageLed(void) {

	if (Oled_statePre != Oled_state) {
		blink_oled = 0;
		blink_oledPre = 100;
		elapsed = 1;
	}
	decide_Oled();

	Oled_statePre = Oled_state;
	//decide torn_stat
	torn_stat = 0;
	for (int i = 0; i < NUM_YARN; i++)
		torn_stat = torn_stat || yarn[i].torn;

	// define the output
	if (torn_stat)
		outHigh = 1;
	else
		outHigh = 0;

	//decide all_off leds
	all_off = 1;
	for (int i = 0; i < NUM_YARN; i++)
		all_off = all_off && (yarn[i].ledState == 0);

	if (outCircuit == 1) {
		torn_stat = 0;
		if (outCircuitPre == 0) {
			flush();
			if (HAL_GPIO_ReadPin(GPIOC, GPIO_PIN_8) == GPIO_PIN_SET) //if off
				HAL_GPIO_WritePin(GPIOC, GPIO_PIN_8, GPIO_PIN_RESET); // make on
			ind = 0;
			direc = 1;
			ledColor = 5;
			Oled_state = 5;
		}
		if (direc == 1) {
			led_set_RGB(ind, LED[ledColor].red, LED[ledColor].green,
					LED[ledColor].blue);
			fillBuffer(ind);

			ind++;

		} else {
			ind--;
			led_set_RGB(ind, 0, 0, 0);
			fillBuffer(ind);

		}
		if (ind == num_led && direc == 1)
			direc = 0;
		else if (ind == 0 && direc == 0) {
			direc = 1;

		}
		led_render();
		//---------------
	} else if (torn_stat == 1) {
		if (torn_statPre == 0) {
			flag = 0;
			flush();
			for (int i = 0; i < num_led; i++) {
				ledColor = yarn[i].ledState;
				if (yarn[i].ledState == 4) {
					led_set_RGB(i, LED[ledColor].red, LED[ledColor].green,
							LED[ledColor].blue);
					indec = i;
					fillBuffer(i);
				} else
					led_set_RGB(i, 0, 0, 0);
			}
			Oled_state = 4;
		}

		if (overFlowFlag > 10) {
			overFlowFlag = 0;
			if (Blink == 1) {
				if (HAL_GPIO_ReadPin(GPIOC, GPIO_PIN_8) == GPIO_PIN_SET) //if off
					HAL_GPIO_WritePin(GPIOC, GPIO_PIN_8, GPIO_PIN_RESET); // make on
			} else
				HAL_GPIO_WritePin(GPIOC, GPIO_PIN_8, GPIO_PIN_SET);

			Blink = !Blink;
		}

		led_render();
		//---------------
	} else if (all_off == 1) {
		Oled_state = 0;
		if (HAL_GPIO_ReadPin(GPIOC, GPIO_PIN_8) == GPIO_PIN_RESET) //if on
			HAL_GPIO_WritePin(GPIOC, GPIO_PIN_8, GPIO_PIN_SET); // make off
	} else {
		//---------------flaw, dirt1, dirt2
		anyUpdate = 0;
		cnt_flaw = 0;
		cnt_dirt = 0;
		Oled_state = 123;
		for (int i = 0; i < num_led; i++) {
			dirt_ind[i] = 0;
			flaw_ind[i] = 0;
		}
		for (uint8_t i = 0; i < num_led; i++) {
			anyUpdate = anyUpdate || (yarn[i].ledState != yarn[i].ledStatePre);
		}
		if (anyUpdate) {
			flush();
			for (int i = 0; i < num_led; i++) {
				ledColor = yarn[i].ledState;
				led_set_RGB(i, LED[ledColor].red, LED[ledColor].green,
						LED[ledColor].blue);
			}
			fillBufferAll();
			for (int i = 0; i < num_led; i++) {
				if (yarn[i].ledState == 1 || yarn[i].ledState == 2) {
					dirt_ind[cnt_dirt] = i + 1;
					cnt_dirt++;
				}
				if (yarn[i].ledState == 3) {
					flaw_ind[cnt_flaw] = i + 1;
					cnt_flaw++;
				}
			}
		}

		if (overFlowFlag > 10) {
			overFlowFlag = 0;
			if (Blink == 1) {
				if (HAL_GPIO_ReadPin(GPIOC, GPIO_PIN_8) == GPIO_PIN_SET) //if off
					HAL_GPIO_WritePin(GPIOC, GPIO_PIN_8, GPIO_PIN_RESET); // make on

			} else
				HAL_GPIO_WritePin(GPIOC, GPIO_PIN_8, GPIO_PIN_SET);

			Blink = !Blink;
		}
		led_render();
	}
	outCircuitPre = outCircuit;
	torn_statPre = torn_stat;
	for (int i = 0; i < num_led; i++)
		yarn[i].ledStatePre = yarn[i].ledState;
}

//decision function (600ms)
void CheckState(void) {
	if (IRreceive == 0) {
		for (int i = 0; i < NUM_YARN; i++)
			yarn_state(&yarn[i]);
	}
}

//SPI--> adjust transmitter power
void MCP41010_Write(uint8_t value) {
	uint8_t data[2];
	data[0] = 0x11; // Write command for Pot 0
	data[1] = value; // Wiper position (0 to 255)

	// Pull CS low to start communication
	HAL_GPIO_WritePin(CS_GPIO_PORT, CS_PIN, GPIO_PIN_RESET);

	// Send the 16-bit command (2 bytes)
	HAL_SPI_Transmit(&hspi1, data, 2, HAL_MAX_DELAY);

	// Pull CS high to end communication
	HAL_GPIO_WritePin(CS_GPIO_PORT, CS_PIN, GPIO_PIN_SET);
}
/* USER CODE END PFP */

/* Private user code ---------------------------------------------------------*/
/* USER CODE BEGIN 0 */

/* USER CODE END 0 */

/**
  * @brief  The application entry point.
  * @retval int
  */
int main(void)
{

  /* USER CODE BEGIN 1 */

  /* USER CODE END 1 */

  /* MCU Configuration--------------------------------------------------------*/

  /* Reset of all peripherals, Initializes the Flash interface and the Systick. */
  HAL_Init();

  /* USER CODE BEGIN Init */

  /* USER CODE END Init */

  /* Configure the system clock */
  SystemClock_Config();

  /* USER CODE BEGIN SysInit */

  /* USER CODE END SysInit */

  /* Initialize all configured peripherals */
  MX_GPIO_Init();
  MX_DMA_Init();
  MX_ADC1_Init();
  MX_ADC2_Init();
  MX_TIM1_Init();
  MX_TIM4_Init();
  MX_USART1_UART_Init();
  MX_TIM3_Init();
  MX_TIM2_Init();
  MX_I2C2_Init();
  MX_SPI1_Init();
  /* USER CODE BEGIN 2 */
	//Show LOGO
//	SSD1306_Init();
//	SSD1306_DrawBitmap(0, 0, logo, 128, 32, 1); // x=0, y=0, width=128, height=32, color=white
//	SSD1306_UpdateScreen(); // Update display to show the bitmap

	//start timers
	HAL_TIM_Base_Start_IT(&htim2);

	IR_Init();
// Calibrate ADCs
	HAL_ADCEx_Calibration_Start(&hadc1, ADC_SINGLE_ENDED);
	HAL_ADCEx_Calibration_Start(&hadc2, ADC_SINGLE_ENDED);
//
//	Start ADCs in independent mode
	HAL_ADC_Start_DMA(&hadc1, (uint32_t*) adc1_data, 6);
	HAL_ADC_Start_DMA(&hadc2, (uint32_t*) adc2_data, 6);
	HAL_TIM_Base_Start(&htim1);
//

	setup_param(&LED[0], 0, 0, 0); //led off
	setup_param(&LED[1], 249, 114, 111); //dirt1
	setup_param(&LED[2], 250, 0, 0); //dirt2
	setup_param(&LED[3], 0, 0, 250); //flaw
	setup_param(&LED[4], 0, 230, 80); //tron
	setup_param(&LED[5], 0, 250, 0); //outcircuit

// Make sure PB3 is high when sending data to neopixels
	HAL_GPIO_WritePin(GPIOC, GPIO_PIN_8, GPIO_PIN_RESET);
//Start Alarm
	rainbow(10);
	HAL_GPIO_WritePin(GPIOC, GPIO_PIN_8, GPIO_PIN_SET);

	SSD1306_Fill(0);
	SSD1306_GotoXY(0, 0);
	SSD1306_Puts("Calibration", &Font_7x10, 1);
	SSD1306_GotoXY(0, 15);
	SSD1306_Puts("Started!", &Font_7x10, 1);
	SSD1306_UpdateScreen();
//	Calibration
	for (int i = 0; i < NUM_YARN; i++) {
		yarn[i].minim = (1 << 12) - 1;
		yarn[i].maxim = 0;
	}
	uint32_t axtim_calib, calib_end;
	uint32_t tim_now = HAL_GetTick();
	calib_end = tim_now + calib_tim;
//	while (tim_now <= calib_end) {
//
//		for (int i = 0; i < NUM_YARN; i++)
//			calibration(&yarn[i]);
//
//		if (HAL_GetTick() - axtim_calib > int_calib) {
//			axtim_calib = HAL_GetTick();
//			for (int i = 0; i < NUM_YARN; i++)
//				resetCalibration(&yarn[i]);
//		}
//		tim_now = HAL_GetTick();
//	}
	flush();
	HAL_GPIO_WritePin(GPIOC, GPIO_PIN_8, GPIO_PIN_RESET);
	//End of Calibration

	SSD1306_Fill(0);
	SSD1306_GotoXY(0, 0);
	SSD1306_Puts("Calibration", &Font_7x10, 1);
	SSD1306_GotoXY(0, 15);
	SSD1306_Puts("Done!", &Font_7x10, 1);
	SSD1306_UpdateScreen();

//	fadeNeopixels();
	HAL_GPIO_WritePin(GPIOC, GPIO_PIN_8, GPIO_PIN_SET);

//	MCP41010_Write(5);
  /* USER CODE END 2 */

  /* Infinite loop */
  /* USER CODE BEGIN WHILE */
	while (1) {
    /* USER CODE END WHILE */

    /* USER CODE BEGIN 3 */
		//Write output
		if (outHigh)
			HAL_GPIO_WritePin(OUTPUT_GPIO_Port, OUTPUT_Pin, GPIO_PIN_SET);
		else
			HAL_GPIO_WritePin(OUTPUT_GPIO_Port, OUTPUT_Pin, GPIO_PIN_RESET);

		///define the transmitters' power
		MCP41010_Write(0);
//		MCP41010_Write(transmitter_power);
		char msg[128];
//		sprintf(msg, "%4u,%4u, %4u,%4u, %4u \r\n", Oled_state, blink_oledPre,
//				blink_oled, counter_oled, elapsed);
//		sprintf(msg,
//				"%4u, %4u, %4u, %4u \r\n",Oled_state,yarn[0].read_sens,yarn[0].per,yarn[0].threshold);

//		sprintf(msg, "%4u ,%4u \r\n", yarn[0].read_sens
//				, transmitter_power);
//		HAL_UART_Transmit(&huart1, (uint8_t*) msg, strlen(msg), 10);

//		sprintf(msg,
//				"%4u, %4u, %4u, %4u, %4u, %4u, %4u, %4u, %4u, %4u, %4u, %4u \r\n",
//				yarn[0].read_sens, yarn[1].read_sens, yarn[2].read_sens,
//				yarn[3].read_sens, yarn[4].read_sens, yarn[5].read_sens,
//				yarn[6].read_sens, yarn[7].read_sens, yarn[8].read_sens,
//				yarn[9].read_sens, yarn[10].read_sens, yarn[11].read_sens);

		sprintf(msg, "%4u,%4u \r\n", yarn[0].read_sens,yarn[0].per);

		HAL_UART_Transmit(&huart1, (uint8_t*) msg, strlen(msg), 10);
//		HAL_Delay(10); // Slow down to avoid UART overrun

		if (FlagCheckState) {
			FlagCheckState = 0;    // Clear flag
			CheckState(); // Execute 600 ms task
		}
		if (FlagLedState == true) {
			FlagLedState = false;
			manageLed();
			overFlowFlag++;
		}

//   	IR Manage
		if (newIRDataFlag == 1) {
			command = (IR_GetCommand() >> 8) & 0xFF; // Update command first
			IR_Reset(); // Clear detection flag
		}

		if (command == 0x00) {
			IRreceivePre = IRreceive;
			IRreceive = 1;
			if (IRreceive != IRreceivePre) {
				outCircuit = !outCircuit;
			}
			command = 100; // Prevent re-triggering
		} else
			IRreceive = 0;

		__WFI();
	}
  /* USER CODE END 3 */
}

/**
  * @brief System Clock Configuration
  * @retval None
  */
void SystemClock_Config(void)
{
  RCC_OscInitTypeDef RCC_OscInitStruct = {0};
  RCC_ClkInitTypeDef RCC_ClkInitStruct = {0};

  /** Configure the main internal regulator output voltage
  */
  HAL_PWREx_ControlVoltageScaling(PWR_REGULATOR_VOLTAGE_SCALE1_BOOST);

  /** Initializes the RCC Oscillators according to the specified parameters
  * in the RCC_OscInitTypeDef structure.
  */
  RCC_OscInitStruct.OscillatorType = RCC_OSCILLATORTYPE_HSE;
  RCC_OscInitStruct.HSEState = RCC_HSE_ON;
  RCC_OscInitStruct.PLL.PLLState = RCC_PLL_ON;
  RCC_OscInitStruct.PLL.PLLSource = RCC_PLLSOURCE_HSE;
  RCC_OscInitStruct.PLL.PLLM = RCC_PLLM_DIV2;
  RCC_OscInitStruct.PLL.PLLN = 85;
  RCC_OscInitStruct.PLL.PLLP = RCC_PLLP_DIV2;
  RCC_OscInitStruct.PLL.PLLQ = RCC_PLLQ_DIV2;
  RCC_OscInitStruct.PLL.PLLR = RCC_PLLR_DIV2;
  if (HAL_RCC_OscConfig(&RCC_OscInitStruct) != HAL_OK)
  {
    Error_Handler();
  }

  /** Initializes the CPU, AHB and APB buses clocks
  */
  RCC_ClkInitStruct.ClockType = RCC_CLOCKTYPE_HCLK|RCC_CLOCKTYPE_SYSCLK
                              |RCC_CLOCKTYPE_PCLK1|RCC_CLOCKTYPE_PCLK2;
  RCC_ClkInitStruct.SYSCLKSource = RCC_SYSCLKSOURCE_PLLCLK;
  RCC_ClkInitStruct.AHBCLKDivider = RCC_SYSCLK_DIV1;
  RCC_ClkInitStruct.APB1CLKDivider = RCC_HCLK_DIV1;
  RCC_ClkInitStruct.APB2CLKDivider = RCC_HCLK_DIV1;

  if (HAL_RCC_ClockConfig(&RCC_ClkInitStruct, FLASH_LATENCY_4) != HAL_OK)
  {
    Error_Handler();
  }
}

/* USER CODE BEGIN 4 */

/* USER CODE END 4 */

/**
  * @brief  This function is executed in case of error occurrence.
  * @retval None
  */
void Error_Handler(void)
{
  /* USER CODE BEGIN Error_Handler_Debug */
	/* User can add his own implementation to report the HAL error return state */
	__disable_irq();
	while (1) {
	}
  /* USER CODE END Error_Handler_Debug */
}

#ifdef  USE_FULL_ASSERT
/**
  * @brief  Reports the name of the source file and the source line number
  *         where the assert_param error has occurred.
  * @param  file: pointer to the source file name
  * @param  line: assert_param error line source number
  * @retval None
  */
void assert_failed(uint8_t *file, uint32_t line)
{
  /* USER CODE BEGIN 6 */
  /* User can add his own implementation to report the file name and line number,
     ex: printf("Wrong parameters value: file %s on line %d\r\n", file, line) */
  /* USER CODE END 6 */
}
#endif /* USE_FULL_ASSERT */
